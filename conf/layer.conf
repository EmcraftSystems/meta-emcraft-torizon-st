## conf/layer.conf
```bitbake
# We have a conf and classes directory, append to BBPATH
BBPATH .= ":${LAYERDIR}"

# We have recipes-* directories, add to BBFILES
BBFILES += "${LAYERDIR}/recipes-*/*/*.bb ${LAYERDIR}/recipes-*/*/*.bbappend"
# Recipes which backport later versions of other layers are placed here.
# Only valid for Toradex distributions.
BACKPORT_BBFILES = "${LAYERDIR}/backports/recipes-*/*/*.bb ${LAYERDIR}/backports/recipes-*/*/*.bbappend"
BBFILES += "${@ d.getVar('BACKPORT_BBFILES') if 'tdx' in d.getVar('DISTROOVERRIDES').split(':') else ''}"

BBFILE_COLLECTIONS += "toradex-st-layer"
BBFILE_PATTERN_toradex-st-layer = "^${LAYERDIR}/"
BBFILE_PRIORITY_toradex-st-layer = "22"

# Let us add layer-specific bbappends which are only applied when that
# layer is included in our configuration
BBFILES += "${@' '.join('${LAYERDIR}/%s/recipes*/*/*.bbappend' % layer \
               for layer in BBFILE_COLLECTIONS.split())}"
# Add layer-specific bb files too
BBFILES += "${@' '.join('${LAYERDIR}/%s/recipes*/*/*.bb' % layer \
               for layer in BBFILE_COLLECTIONS.split())}"

LAYERDEPENDS_toradex-st-layer = " \
    core \
    stm-st-stm32mp \
    toradex-bsp-common-layer \
"

LAYERSERIES_COMPAT_toradex-st-layer = "scarthgap"

# NOTE: don't apply I.MX firmware for STM32MP1/2 targets
BBMASK:stm32mp2common += "meta-toradex-bsp-common/recipes-kernel/linux-firmware/linux-firmware_%.bbappend"
BBMASK:stm32mp1common += "meta-toradex-bsp-common/recipes-kernel/linux-firmware/linux-firmware_%.bbappend"

# NOTE: disable ST images not required for TorizonOS distro
ST_BOOTFS:stm32mp2common   ?= "0"
ST_VENDORFS:stm32mp2common ?= "0"
ST_USERFS:stm32mp2common   ?= "0"
ST_BOOTFS:stm32mp1common   ?= "0"
ST_VENDORFS:stm32mp1common ?= "0"
ST_USERFS:stm32mp1common   ?= "0"

# NOTE: remove dependency on userfs since we don't build it
WKS_FILE_DEPENDS:remove:stm32mp2common = "st-image-userfs"
WKS_FILE_DEPENDS:remove:stm32mp1common = "st-image-userfs"

# Apply TorizonOS boot script and U-Boot env structure with specifics to STM32MP2 U-Boot
BBMASK:stm32mp2common += "meta-toradex-torizon/recipes-bsp/u-boot/u-boot-distro-boot.bbappend"
BBMASK:stm32mp2common += "meta-toradex-torizon/recipes-bsp/u-boot/u-boot-distro-boot.bb"
BBMASK:stm32mp1common += "meta-toradex-torizon/recipes-bsp/u-boot/u-boot-distro-boot.bbappend"
BBMASK:stm32mp1common += "meta-toradex-torizon/recipes-bsp/u-boot/u-boot-distro-boot.bb"
PREFERRED_PROVIDER_u-boot-default-script = "u-boot-distro-boot"

# STM32MP2 bootarg to enable UART console
OSTREE_KERNEL_ARGS:stm32mp2common = "earlyprintk earlycon console=ttySTM0,115200"
OSTREE_KERNEL_ARGS:stm32mp1common = "earlyprintk earlycon console=ttySTM0,115200"

# Build ext4 image for the OSTree based OTA image
TEZI_ROOT_SUFFIX:stm32mp2common = "ota-ext4"
TEZI_ROOT_SUFFIX:stm32mp1common = "ota-ext4"

# Use ota-ext4 image instead of default ext4 for rootfs and mark the rootfs partiotion as System.
# Note that rootfs is the only filesystem image to be installed since bootfs, vendorfs and
# userfs images are disabled in the TorizonOS distro, so it is ok to change the common suffix.
PARTITIONS_SUFFIX = "ota-ext4"
PARTITIONS_IMAGES[rootfs] = "${STM32MP_ROOTFS_IMAGE},${STM32MP_ROOTFS_LABEL},,${STM32MP_ROOTFS_SIZE},System"

# Enable built eMMC images for the Disco target
BOOTDEVICE_LABELS:append:stm32mp25-disco = " emmc"
STM32MP_DT_FILES_EMMC:stm32mp25-disco    += "stm32mp257f-dk"
EXTERNAL_DEVICETREE_EMMC:stm32mp25-disco = "stm32mp257f-dk-ca35tdcid-ostl"
EXTERNAL_DEVICETREE_EMMC:stm32mp25-disco =+ "stm32mp257f-dk-ca35tdcid-ostl-m33-examples"
```
